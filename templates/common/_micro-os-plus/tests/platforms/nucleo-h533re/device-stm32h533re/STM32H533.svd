# STM32H533 register map
File version: 1.3
CPU: CM33 r0p0, little endian, MPU, FPU, 4 interrupt priority bits
Registers are 32-bit, read-write, reset 0x0 unless marked. A register's access mark holds for its fields unless they carry their own. Offsets are from the block's base; lines under a group give offsets from that group; [hi:lo] are bit positions; {n}, {i} and the like mark numbered series; 'fields as' and 'values as' point back to an identical list; <NAME> marks a mode.

## Memory map
0x40000000 TIM2 size 0x3E4 — TIM2 address block description
0x40000400 TIM3 size 0x3E4 — TIM3 address block description
0x40000800 TIM4 size 0x3E4 — TIM4 address block description
0x40000C00 TIM5 size 0x3E4 — TIM5 address block description
0x40001000 TIM6 size 0x30 — TIM6 address block description
0x40001400 TIM7 size 0x30 — TIM7 address block description
0x40001800 TIM12 size 0x400 — General-purpose timers
0x40002C00 WWDG size 0xC — WWDG address block description
0x40003000 IWDG size 0x18 — IWDG address block description
0x40003800 SPI2 size 0x54
0x40003C00 SPI3 size 0x54
0x40004400 USART2 size 0x30
0x40004800 USART3 size 0x30
0x40004C00 UART4 size 0x30
0x40005000 UART5 size 0x30
0x40005400 I2C size 0x2C — I2C address block description
0x40005800 I2C2 size 0x2C
0x40005C00 I3C size 0x400 — I3C register block
0x40006000 CRS size 0x10 — CRS address block description
0x40006400 USART6 size 0x30
0x40008C00 DTS size 0x30 — DTS address block description
0x40009400 LPTIM2 size 0x38 — LPTIM2 address block description
0x4000A400 FDCAN size 0x400 — FDCAN register blank and RAM
0x4000A800 FDCAN2 size 0x400
0x4000DC00 UCPD size 0x400 — UCPD register block
0x40012C00 TIM1 size 0x3E4 — TIM1 address block description
0x40013000 SPI size 0x54 — SPI address block description
0x40013400 TIM8 size 0x3E4 — TIM8 address block description
0x40013800 USART size 0x30 — USART address block description
0x40014000 TIM15 size 0x3E4 — TIM15 address block description
0x40014C00 SPI4 size 0x54
0x40016000 USB size 0x5C — USB address block description
0x40016400 USBSRAM size 0x40 — USBSRAM address block description
0x40020000 GPDMA size 0x1000 — GPDMA register block
0x40021000 GPDMA2 size 0x1000
0x40022000 FLASH size 0x400 — Mustang_FLASH register block
0x40023000 CRC size 0x18 — CRC address block description
0x40026000 RAMCFG size 0x12C — RAMCFG address block description
0x40030400 ICACHE size 0x400 — ICACHE register block
0x40031400 DCACHE size 0x400 — DCACHE register block
0x40032400 GTZC1_TZIC size 0x30 — GTZC1_MPCBBz register block
0x40036400 GTZC1_TZSC size 0x80 — GTZC1_MPCBBz register block
0x42020000 GPIOA size 0x34 — GPIOA address block description
0x42020400 GPIOB size 0x34 — GPIOB address block description
0x42020800 GPIOC size 0x34 — GPIOC address block description
0x42020C00 GPIOD size 0x34 — GPIOD address block description
0x42021000 GPIOE size 0x34 — GPIOE address block description
0x42021400 GPIOF size 0x34 — GPIOF address block description
0x42021800 GPIOG size 0x34 — GPIOG address block description
0x42021C00 GPIOH size 0x34 — GPIOH address block description
0x42028000 ADC size 0xCC — ADC register block
0x42028100 ADC2 size 0xCC
0x42028300 ADCC size 0x100 — ADC common registers block
0x42028400 DAC size 0x50 — DAC address block description
0x4202C000 DCMI size 0x2C — DCMI address block description
0x4202C400 PSSI size 0x400 — PSSI register block
0x420C0000 AES size 0x400 — AES register block
0x420C0400 HASH size 0x400 — HASH register bank
0x420C0800 RNG size 0x14 — RNG address block description
0x420C0C00 SAES size 0x400 — SAES register block
0x420C2000 PKA size 0x2000 — PKA register blank and RAM
0x44000400 SBS size 0x150 — SBS address block description
0x44002400 LPUART size 0x30 — LPUART address block description
0x44002800 I2C3 size 0x2C
0x44003000 I3C2 size 0x400
0x44004400 LPTIM1 size 0x38 — LPTIM1 address block description
0x44007400 VREFBUF size 0x8 — VREFBUF address block description
0x44007800 RTC size 0x400 — RTC register block
0x44007C00 TAMP size 0x400 — TAMP register block
0x44020800 PWR size 0x108 — PWR address block description
0x44020C00 RCC size 0x118 — RCC address block description
0x44022000 EXTI size 0x98 — EXTI address block description
0x44024000 DBGMCU size 0x1000 — DBGMCU register block
0x46005000 OTFDEC size 0x400 — OTFDEC register bank
0x46008000 SDMMC size 0xC0 — SDMMC address block description
0x46008400 DLYBSD1 size 0x8
0x4600F000 DLYBOS1 size 0x8 — DLYB address block description
0x47000400 FMC size 0x15C — FMC address block description
0x47001400 OCTOSPI size 0x400 — OCTOSPI register block
0x50000000 TIM2_S size 0x3E4
0x50000400 TIM3_S size 0x3E4
0x50000800 TIM4_S size 0x3E4
0x50000C00 TIM5_S size 0x3E4
0x50001000 TIM6_S size 0x30
0x50001400 TIM7_S size 0x30
0x50001800 SEC_TIM12 size 0x400
0x50002C00 WWDG_S size 0xC
0x50003000 IWDG_S size 0x18
0x50003800 SPI2_S size 0x54
0x50003C00 SPI3_S size 0x54
0x50004400 USART2_S size 0x30
0x50004800 USART3_S size 0x30
0x50004C00 UART4_S size 0x30
0x50005000 UART5_S size 0x30
0x50005400 I2C_S size 0x2C
0x50005800 I2C2_S size 0x2C
0x50005C00 I3C_S size 0x400
0x50006000 CRS_S size 0x10
0x50006400 USART6_S size 0x30
0x50008C00 DTS_S size 0x30
0x50009400 LPTIM2_S size 0x38
0x5000A400 FDCAN_S size 0x400
0x5000A800 FDCAN2_S size 0x400
0x5000DC00 UCPD_S size 0x400
0x50012C00 TIM1_S size 0x3E4
0x50013000 SPI_S size 0x54
0x50013400 TIM8_S size 0x3E4
0x50013800 USART_S size 0x30
0x50014000 TIM15_S size 0x3E4
0x50014C00 SPI4_S size 0x54
0x50016000 USB_S size 0x5C
0x50016400 USBSRAM_S size 0x40
0x50020000 GPDMA_S size 0x1000
0x50021000 GPDMA2_S size 0x1000
0x50022000 FLASH_S size 0x400
0x50023000 CRC_S size 0x18
0x50026000 RAMCFG_S size 0x12C
0x50030400 ICACHE_S size 0x400
0x50031400 DCACHE_S size 0x400
0x50032400 GTZC1_TZIC_S size 0x30
0x50036400 GTZC1_TZSC_S size 0x80
0x52020000 GPIOA_S size 0x34
0x52020400 GPIOB_S size 0x34
0x52020800 GPIOC_S size 0x34
0x52020C00 GPIOD_S size 0x34
0x52021000 GPIOE_S size 0x34
0x52021400 GPIOF_S size 0x34
0x52021800 GPIOG_S size 0x34
0x52021C00 GPIOH_S size 0x34
0x52028000 ADC_S size 0xCC
0x52028100 ADC2_S size 0xCC
0x52028300 SEC_ADCC size 0x100
0x52028400 DAC_S size 0x50
0x5202C000 DCMI_S size 0x2C
0x5202C400 PSSI_S size 0x400
0x520C0000 AES_S size 0x400
0x520C0400 HASH_S size 0x400
0x520C0800 RNG_S size 0x14
0x520C0C00 SAES_S size 0x400
0x520C2000 PKA_S size 0x2000
0x54000400 SBS_S size 0x150
0x54002400 LPUART_S size 0x30
0x54002800 I2C3_S size 0x2C
0x54003000 I3C2_S size 0x400
0x54004400 LPTIM1_S size 0x38
0x54007400 VREFBUF_S size 0x8
0x54007800 RTC_S size 0x400
0x54007C00 TAMP_S size 0x400
0x54020800 PWR_S size 0x108
0x54020C00 RCC_S size 0x118
0x54022000 EXTI_S size 0x98
0x54024000 DBGMCU_S size 0x1000
0x56005000 OTFDEC_S size 0x400
0x56008000 SDMMC_S size 0xC0
0x56008400 DLYBSD1_S size 0x8
0x5600F000 DLYBOS1_S size 0x8
0x57000400 FMC_S size 0x15C
0x57001400 OCTOSPI_S size 0x400
0xE000E000 SCnSCB size 0x10 — System Control and ID Registers not in the SCB address range: ICTR (Interrupt Controller Type Register), ACTLR (Auxiliary Control Register), and CPPWR (Coprocessor Power Control -- new in ARMv8-M Mainline). Verified against CMSIS_6 core_cm33.h. Absent entirely on ARMv8-M Baseline, same as ARMv6-M.
0xE000E010 SysTick size 0x10 — SysTick Timer. Identical register set on every Cortex-M core (ARMv6-M through current ARMv8-M).
0xE000E100 NVIC size 0xE04 — Nested Vectored Interrupt Controller. ARMv8-M packs interrupt state into 16 banks of 32 bits each (ISER/ICER/ISPR/ICPR/IABR/ITNS) plus 124 32-bit IPR words, covering the full architectural maximum of 496 external interrupts (verified against CMSIS_6 core_cm23.h/core_cm33.h: IPR is a 496-byte array, i.e. 124 words of 4 packed 8-bit priorities each -- same total on both profiles). ITNS (Interrupt Target Non-Secure) is new versus ARMv6-M/ARMv7-M: one bit per interrupt selecting whether it targets the Secure or the Non-secure state; Secure-only access, and RAZ/WI when the Security Extension is not implemented. Mainline additionally has STIR, at the same offset as on ARMv7-M.
0xE000ED00 SCB blocks up to offset 0xEC — System Control Block, ARMv8-M Mainline register set. Verified against CMSIS_6 core_cm33.h. Superset of ARMv7-M's SCB plus the Security Extension: NSACR (Non-secure Access Control), SFSR/SFAR (Secure Fault Status/Address -- physically the same registers CMSIS also exposes via SAU->SFSR/SFAR; modeled once here, under SCB, since SAU and SCB share the same 0xE000ED00-0xE000EDEF page -- see the two <addressBlock> entries below and the SAU peripheral's description), and extra ICSR/AIRCR/SCR/SHCSR/CFSR bits (see the individual register descriptions). ID_ISAR now has 6 words (ID_ISAR5 added) versus 5 on ARMv7-M; the ID_* register names themselves also changed (ADR/DFR -> ID_AFR/ID_DFR) to match current CMSIS naming for ARMv8-M. Deliberately excluded, same rationale as ARMv7-M: CFSR.MLSPERR/LSPERR (FPU lazy-stacking bits) are documented but the FPU block itself is not modeled, and the cache-maintenance registers present on cache-capable implementations (CLIDR/CTR/CCSIDR/CSSELR, ICIALLU..BPIALL, MVFR0-2, CCR.DC/IC/BP -- Cortex-M55/M85-specific) are out of scope, same as trace components (ITM/DWT/TPIU).
0xE000ED90 MPU size 0x38 — Memory Protection Unit -- OPTIONAL on ARMv8-M Mainline (__MPU_PRESENT). Region format changed from ARMv7-M's RBAR/RASR (base + size-encoded) to RBAR/RLAR (base + limit), and gained MAIR0/MAIR1 memory-attribute indirection registers (verified against CMSIS_6 core_cm23.h/core_cm33.h). Includes 3 alias RBAR/RLAR pairs, same as ARMv7-M (MPU_TYPE_RALIASES=4). RLAR.PXN (Privileged eXecute Never, bit 4) is Mainline-only -- absent from Baseline's RLAR entirely, not just RAZ/WI.
0xE000EDD0 SAU size 0x14 — Security Attribution Unit -- present only when the Security Extension (TrustZone) is implemented; absent entirely on a Non-secure-only/single-state part. RNR/RBAR/RLAR are further optional within that: only present when __SAUREGION_PRESENT=1, i.e. the implementation has at least one programmable SAU region (a part can implement the Security Extension with the whole memory map fixed Secure/Non-secure by IDAU alone and no SAU regions at all). Verified against CMSIS_6 core_cm23.h/core_cm33.h (identical on both profiles). SFSR/SFAR are modeled once, under SCB, since SAU_Type and SCB_Type both expose the same physical registers at the same address on Mainline -- CMSIS_6 now says so explicitly (SAU_Type's own SFSR/SFAR are commented "deprecated: use SCB->SFSR"/"SCB->SFAR"); Baseline has neither (no SecureFault handler exists there).
0xE000EDF0 DCB size 0x1C — Debug Control Block -- CMSIS's ARMv8-M name for what core_cm0.h/core_cm3.h call CoreDebug (same base address, 0xE000EDF0). Adds DAUTHCTRL (Debug Authentication Control) and DSCSR (Debug Security Control and Status) versus ARMv6-M/ARMv7-M's CoreDebug -- both Security-Extension-related, present regardless of profile. Verified against CMSIS_6 core_cm23.h/core_cm33.h.

## Interrupts
0 WWDG — Window Watchdog interrupt
2 RTC — RTC global non-secure interrupts
3 RTC_S (RTC) — RTC global secure interrupts
4 TAMP — Tamper global interrupts
5 RAMCFG — RAM configuration global interrupt
6 FLASH — Flash non-secure global interrupt
7 FLASH_S — Flash secure global interrupt
8 GTZC (GTZC1_TZIC) — GTZC global interrupt
9 RCC — RCC non-secure global interrupt
10 RCC_S (RCC) — RCC secure global interrupt
{n+11} EXTI{n} (EXTI) (n=0..15) — EXTI Line{n} interrupt
{n+27} GPDMA1_CH{n} (GPDMA) (n=0..7) — GPDMA1 channel{n} global interrupt
35 IWDG — Independent watchdog interrupt
36 SAES — Secure AES
37 ADC1 (ADC) — ADC1 global interrupt
38 DAC1 (DAC) — DAC1 global interrupt
39 FDCAN1_IT0 (FDCAN) — FDCAN1 Interrupt 0
40 FDCAN1_IT1 (FDCAN) — FDCAN1 Interrupt 1
41 TIM1_BRK_TERR_IERR (TIM1) — TIM1 Break/TIM1 Transition error/TIM1 Index error
42 TIM1_UPD (TIM1) — TIM1 Update
43 TIM1_TRGI_COM_DIR_IDX (TIM1) — TIM1 trigger and commutation/TIM1 Direction Change interrupt/TIM1 Index
44 TIM1_CC (TIM1) — TIM1 capture compare interrupt
45 TIM2 — TIM2 global interrupt
46 TIM3 — TIM3 global interrupt
47 TIM4 — TIM4 global interrupt
48 TIM5 — TIM5 global interrupt
49 TIM6 — TIM6 global interrupt
50 TIM7 — TIM7 global interrupt
51 I2C1_EV (I2C) — I2C1 event interrupt
52 I2C1_ERR (I2C) — I2C1 error interrupt
53 I2C2_EV (I2C2) — I2C2 event interrupt
54 I2C2_ERR (I2C2) — I2C2 error interrupt
55 SPI1 (SPI) — SPI1 global interrupt
56 SPI2 — SPI2 global interrupt
57 SPI3 — SPI3 global interrupt
58 USART1 (USART) — USART1 global interrupt
59 USART2 — USART2 global interrupt
60 USART3 — USART3 global interrupt
61 UART4 — UART4 global interrupt
62 UART5 — UART5 global interrupt
63 LPUART1 (LPUART) — LPUART1 global interrupt OR LPUART1 R Wakeup OR LPUART1 T Wakeup Char(10)through EXTI line
64 LPTIM1 — LPTIM1 global interrupt OR LPTimer1 AIT through EXTI line
65 TIM8_BRK_TERR_IERR (TIM8) — TIM8 Break interrupt/TIM8 Transition error/TIM8 Index error
66 TIM8_UPD (TIM8) — TIM8 Update interrupt
67 TIM8_TRGI_DIR_IDX (TIM8) — TIM8 trigger and commutation interrupt/TIM8 Direction Change interrupt/TIM8 Index
68 TIM8_CC (TIM8) — TIM8 capture compare interrupt
69 ADC2 — ADC2 global interrupt
70 LPTIM2 — LPTIM2 global interrupt OR LPTimer2 AIT through EXTI line
71 TIM15 — TIM15 global interrupt
74 USB_FS (USB) — USB OTG FS global interrupt
75 CRS — Clock Recovery System global interrupt
76 UCPD1 (UCPD) — UCPD1 global interrupt
77 FMC — FMC global interrupt
78 OCTOSPI1 (OCTOSPI) — OCTOSPI1 global interrupt
79 SDMMC1 (SDMMC) — SDMMC1 global interrupt
80 I2C3_EV (I2C3) — I2C3 event interrupt
81 I2C3_ERR (I2C3) — I2C3 error interrupt
82 SPI4 — SPI4 global interrupt
85 USART6 — USART6 global interrupt
90 GPDMA2_CH0 (GPDMA2) — GPDMA2 channel0 global interrupt
91 GPDMA2_CH1 (GPDMA2) — GPDMA2 channel1 global interrupt
92 GPDMA2_CH2 (GPDMA2) — GPDMA2 channel2 global interrupt
93 GPDMA2_CH3 (GPDMA2) — GPDMA2 channe3 global interrupt
94 GPDMA2_CH4 (GPDMA2) — GPDMA2 channel4 global interrupt
95 GPDMA2_CH5 (GPDMA2) — GPDMA2 channel5 global interrupt
96 GPDMA2_CH6 (GPDMA2) — GPDMA2 channel6 global interrupt
97 GPDMA2_CH7 (GPDMA2) — GPDMA2 channel7 global interrupt
103 FPU (EXTI) — Floating point interrupt
104 ICACHE — Instruction cache global interrupt
105 DCACHE — Data cache global interrupt
108 DCMI_PSSI (DCMI) — DCMI/PSSI global interrupt
109 FDCAN2_IT0 (FDCAN2) — FDCAN2 Interrupt 0
110 FDCAN2_IT1 (FDCAN2) — FDCAN2 Interrupt 1
113 DTS_OR_DTS_WKUP (DTS) — DTS interrupt OR DTS AIT through EXTI line
114 RNG — RNG global interrupt
115 OTFDEC1 (OTFDEC) — OTFDEC1 secure global interrupt
116 AES — AES global interrupt
117 HASH — HASH interrupt
118 PKA — PKA global interrupt
119 CEC (EXTI) — HDMI-CEC global interrupt
120 TIM12 — TIM12 global interrupt
123 I3C1_EV (I3C) — I3C1 event interrupt
124 I3C1_ERR (I3C) — I3C1 error interrupt
131 I3C2_EV (I3C2) — I3C2 event interrupt
132 I3C2_ERR (I3C2) — I3C2 error interrupt

## Notices in the file
Copyright (c) 2025 STMicroelectronics.
SPDX-License-Identifier: Apache-2.0
Licensed under the Apache License, Version 2.0 (the "License");
you may not use this file except in compliance with the License.
You may obtain a copy of the License at
http://www.apache.org/licenses/LICENSE-2.0
Unless required by applicable law or agreed to in writing, software
distributed under the License is distributed on an "AS IS" BASIS,
WITHOUT WARRANTIES OR CONDITIONS OF ANY KIND, either express or implied.
See the License for the specific language governing permissions and
limitations under the License.
